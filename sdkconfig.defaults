## sdkconfig.defaults
```kconfig
# --- 目标芯片 ---
CONFIG_IDF_TARGET="esp32c3"

# --- Flash ---
CONFIG_ESPTOOLPY_FLASHSIZE_8MB=y
CONFIG_ESPTOOLPY_HEADER_FLASHSIZE_UPDATE=n
CONFIG_PARTITION_TABLE_CUSTOM=y
CONFIG_PARTITION_TABLE_CUSTOM_FILENAME="partitions.csv"
CONFIG_PARTITION_TABLE_FILENAME="partitions.csv"

# --- 控制台:USB-Serial-JTAG ---
CONFIG_ESP_CONSOLE_USB_SERIAL_JTAG=y
CONFIG_ESP_CONSOLE_SECONDARY_NONE=y

# --- LVGL ---
CONFIG_LV_COLOR_DEPTH_16=y
CONFIG_LV_FONT_MONTSERRAT_14=y
CONFIG_LV_FONT_MONTSERRAT_20=y
# 使用系统堆 (截屏快照约 150KB, 超出内置内存池)
CONFIG_LV_USE_CLIB_MALLOC=y
CONFIG_LV_USE_SNAPSHOT=y

# --- 系统 ---
CONFIG_FREERTOS_HZ=1000

# --- Bluetooth LE / Bluedroid (官方 esp_hid 组件, 参考示例 esp_hid_device) ---
CONFIG_BT_ENABLED=y
CONFIG_BT_BLUEDROID_ENABLED=y
CONFIG_BT_BLE_ENABLED=y
CONFIG_BT_BLE_42_FEATURES_SUPPORTED=y
# 注: SMP(配对加密)默认已开启; HID 服务由 esp_hid 组件构建, 无需额外开关
# 关闭不用的 Bluedroid 功能，节省内存（参考官方 ble_hid_device_demo）
# CONFIG_BT_GATTC_ENABLE is not set
# CONFIG_BT_BLE_42_SCAN_EN is not set
# CONFIG_BT_BLE_42_DTM_TEST_EN is not set
```
